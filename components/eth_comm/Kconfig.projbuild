## components/eth_comm/Kconfig.projbuild
```kconfig
menu "Ethernet Communication Configuration"

    config OLIMEX_ESP32_POE
        bool "Using Olimex ESP32-POE board"
        default y
        help
            Set to true if using Olimex ESP32-POE board.
    
    config ETH_MDC_GPIO
        int "SMI MDC GPIO number"
        default 23
        help
            Set the GPIO number used by SMI MDC.

    config ETH_MDIO_GPIO
        int "SMI MDIO GPIO number"
        default 18
        help
            Set the GPIO number used by SMI MDIO.

    config ETH_PHY_RST_GPIO
        int "PHY Reset GPIO number"
        default -1
        help
            Set the GPIO number used to reset PHY chip.
            Set to -1 to disable PHY chip hardware reset.

    config ETH_PHY_ADDR
        int "PHY Address"
        range 0 31
        default 0
        help
            Set PHY address according your board schematic.

    config ETH_PHY_POWER_PIN
        int "PHY Power pin number"
        range 0 31
        default 12
        help
            Set PHY Power pin number according your board schematic.
endmenu
```
